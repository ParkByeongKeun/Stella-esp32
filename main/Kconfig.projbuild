## main/Kconfig.projbuild
```kconfig
menu "Example Configuration"

    config EXAMPLE_STORE_HISTORY
        bool "Store command history in flash"
        default y
        help
            Linenoise line editing library provides functions to save and load
            command history. If this option is enabled, initalizes a FAT filesystem
            and uses it to store command history.

    config EXAMPLE_I2C_MASTER_SCL
        int "SCL GPIO Num"
        default 19 if IDF_TARGET_ESP32
        default 4
        help
            GPIO number for I2C Master clock line.

    config EXAMPLE_I2C_MASTER_SDA
        int "SDA GPIO Num"
        default 18 if IDF_TARGET_ESP32
        default 5
        help
            GPIO number for I2C Master data line.

    choice EXAMPLE_IP_MODE
        prompt "IP Version"
        depends on EXAMPLE_SOCKET_IP_INPUT_STRING
        help
            Example can use either IPV4 or IPV6.

        config EXAMPLE_IPV4
            bool "IPV4"

        config EXAMPLE_IPV6
            bool "IPV6"

    endchoice

    config EXAMPLE_IPV4_ADDR
        string "IPV4 Address"
        default "192.168.0.165"
        depends on EXAMPLE_IPV4
        help
            The example will connect to this IPV4 address.

    config EXAMPLE_IPV6_ADDR
        string "IPV6 Address"
        default "FE80::30AD:E57B:C212:68AD"
        depends on EXAMPLE_IPV6
        help
            The example will connect to this IPV6 address.

    config EXAMPLE_PORT
        int "Port"
        range 0 65535
        default 3333
        help
            The remote port to which the client example will connect to.

    choice EXAMPLE_INTERFACE
        prompt "Interface selection"
        depends on EXAMPLE_IPV6
        help
            Example can use either "Auto" or "User specified".

        config EXAMPLE_IFACE_AUTO
            bool "Auto"

        config EXAMPLE_USER_SPECIFIED_IFACE
            bool "User specified interface"
    endchoice

    config EXAMPLE_USER_SPECIFIED_IFACE_NAME
        string "User specified interface name"
        default "st1"
        depends on EXAMPLE_USER_SPECIFIED_IFACE
        help
            This interface will be used for communication.

    choice EXAMPLE_SOCKET_IP_INPUT
        prompt "Socket example source"
        default EXAMPLE_SOCKET_IP_INPUT_STRING
        help
            Selects the input source of the IP used in the example.

        config EXAMPLE_SOCKET_IP_INPUT_STRING
            bool "From string"

        config EXAMPLE_SOCKET_IP_INPUT_STDIN
            bool "From stdin"
    endchoice

endmenu

menu "I2S PDM Example Configuration"

    choice EXAMPLE_PDM_DIR
        prompt "I2S PDM direction"
        default EXAMPLE_PDM_TX
        help
            Select example PDM direction

        config EXAMPLE_PDM_TX
            bool "PDM TX"
            depends on SOC_I2S_SUPPORTS_PDM_TX
            help
                PDM TX example will play 'twinkle twinkle little star' in three tones.

        config EXAMPLE_PDM_RX
            bool "PDM RX"
            depends on SOC_I2S_SUPPORTS_PDM_RX
            help
                PDM RX example will show the received data from a PDM microphone.
    endchoice

    choice EXAMPLE_PDM_TX_LINE_MODE
        prompt "I2S PDM TX Line Mode"
        depends on EXAMPLE_PDM_TX && SOC_I2S_HW_VERSION_2
        default EXAMPLE_PDM_TX_CODEC
        help
            Decide to output PDM signal into a PDM codec or a low-pass filter

        config EXAMPLE_PDM_TX_CODEC
            bool "Codec line mode"
            help
                Output PDM signal to a PDM codec. The PDM clock signal is mandatory for PDM codec,
                the codec can differentiate the left and right sound channels by sampling data
                on positive or negative edges. That means the data of the left and right channels
                can coexist on a same data line.

        config EXAMPLE_PDM_TX_DAC
            bool "DAC line mode"
            help
                Output PDM signal to a low-pass filter, so that the low-pass filter can restore the PDM
                signal to analog wave. Therefore, each data line can only contains one sound channel,
                if both left and right channels are required, two data lines should be specified as well.
                Normally the PDM signal is not sufficient in DAC line mode.
    endchoice

endmenu


menu "Example SPI-ADC Configuration"

    config EXAMPLE_USE_SPI1_PINS
        bool "The example uses SPI1 shared pins for EEPROM connection"
        default n
        depends on SPI_FLASH_SHARE_SPI1_BUS
        select GPIO_CTRL_FUNC_IN_IRAM
        select COMPILER_OPTIMIZATION_CHECKS_SILENT # silent the error check, as the error string are stored in rodata
        help
            Enable this option will make the EEPROM use SPI1 pins, which is shared with the main
            flash chip. Therefore, when doing transaction on SPI1 bus, data cannot be fetched
            from the flash, so all the data used during this time should be put into the internal RAM.

            Currently this example hasn't supported SPI1 pins on other chips yet.

    config EXAMPLE_INTR_USED
        bool "Use the interrupt to detect the eeprom busy"
        default y
        depends on !EXAMPLE_USE_SPI1_PINS
        help
            Enable this option will allow the example to be blocked while the EEPROM is working
            in progress, and unblocked by GPIO interrupt. Otherwise the example will keep polling
            until the EEPROM is idle.

    config EXAMPLE_5V_COMMANDS
        bool "The EEPROM is supplied by 5V power"
        default n
        help
            The Erase_All and Write_All commands of EEPROM are only supported when EEPROM is
            supplied by 5V power. Enable this to use those two commands.

            But please note that ESP chips don't support 5V IO, you need to add external
            level-shifting circuits between ESP chip to the EEPROM.

endmenu


menu "Example Nimble_Security Configuration"

    orsource "$IDF_PATH/examples/common_components/env_caps/$IDF_TARGET/Kconfig.env_caps"

    choice BLINK_LED
        prompt "Blink LED type"
        default BLINK_LED_GPIO
        help
            Select the LED type. A normal level controlled LED or an addressable LED strip.
            The default selection is based on the Espressif DevKit boards.
            You can change the default selection according to your board.

        config BLINK_LED_GPIO
            bool "GPIO"
        config BLINK_LED_STRIP
            bool "LED strip"
    endchoice

    choice BLINK_LED_STRIP_BACKEND
        depends on BLINK_LED_STRIP
        prompt "LED strip backend peripheral"
        default BLINK_LED_STRIP_BACKEND_RMT if SOC_RMT_SUPPORTED
        default BLINK_LED_STRIP_BACKEND_SPI
        help
            Select the backend peripheral to drive the LED strip.

        config BLINK_LED_STRIP_BACKEND_RMT
            depends on SOC_RMT_SUPPORTED
            bool "RMT"
        config BLINK_LED_STRIP_BACKEND_SPI
            bool "SPI"
    endchoice

    config BLINK_GPIO
        int "Blink GPIO number"
        range ENV_GPIO_RANGE_MIN ENV_GPIO_OUT_RANGE_MAX
        default 8
        help
            GPIO number (IOxx) to blink on and off the LED.
            Some GPIOs are used for other purposes (flash connections, etc.) and cannot be used to blink.

endmenu

menu "Example MESH Configuration"
#/--------------------------------------------------
    choice
        bool "Mesh Topology"
        default MESH_TOPO_TREE
        help
            Mesh Network Topology.

        config MESH_TOPO_TREE
            bool "MESH_TOPO_TREE"
        config MESH_TOPO_CHAIN
            bool "MESH_TOPO_CHAIN"
    endchoice

    config MESH_TOPOLOGY
        int
        default 0 if MESH_TOPO_TREE
        default 1 if MESH_TOPO_CHAIN
        help
            Mesh Network Topology.
#/--------------------------------------------------
    config MESH_CHANNEL
        int "channel"
        range 0 14
        default 0
        help
            mesh network channel.

    config MESH_ROUTER_SSID
        string "Router SSID"
        default "ROUTER_SSID"
        help
            Router SSID.

    config MESH_ROUTER_PASSWD
        string "Router password"
        default "ROUTER_PASSWD"
        help
            Router password.

    choice
        bool "Mesh AP Authentication Mode"
        default WIFI_AUTH_WPA2_PSK
        help
            Authentication mode.

        config WIFI_AUTH_OPEN
            bool "WIFI_AUTH_OPEN"
        config WIFI_AUTH_WPA_PSK
            bool "WIFI_AUTH_WPA_PSK"
        config WIFI_AUTH_WPA2_PSK
            bool "WIFI_AUTH_WPA2_PSK"
        config WIFI_AUTH_WPA_WPA2_PSK
            bool "WIFI_AUTH_WPA_WPA2_PSK"
    endchoice

    config MESH_AP_AUTHMODE
        int
        default 0 if WIFI_AUTH_OPEN
        default 2 if WIFI_AUTH_WPA_PSK
        default 3 if WIFI_AUTH_WPA2_PSK
        default 4 if WIFI_AUTH_WPA_WPA2_PSK
        help
            Mesh AP authentication mode.

    config MESH_AP_PASSWD
        string "Mesh AP Password"
        default "MAP_PASSWD"
        help
            Mesh AP password.

    config MESH_AP_CONNECTIONS
        int "Mesh AP Connections"
        range 1 10
        default 6
        help
            The number of mesh stations allowed to connect in.

    config MESH_NON_MESH_AP_CONNECTIONS
        int "Mesh Non Mesh AP Connections"
        range 0 9
        default 0
        help
            The number of non-mesh stations allowed to connect in.

    config MESH_MAX_LAYER
        int "Mesh Max Layer"
        range 1 25
        default 6
        help
            Max layer allowed in mesh network.

    config MESH_ROUTE_TABLE_SIZE
        int "Mesh Routing Table Size"
        range 1 300
        default 50
        help
            The number of devices over the network(max: 300).

    config MESH_USE_GLOBAL_DNS_IP
        bool "Use global DNS IP"
        default n
        help
            Use fixed DNS server IP address. If enabled, root node
            advertises the specified DNS address in DHCP packets.
            By default it uses DNS record received from the router.

    config MESH_GLOBAL_DNS_IP
        hex "Global DNS"
        depends on MESH_USE_GLOBAL_DNS_IP
        default 0x08080808
        help
            The IP address of global DNS server that is used
            for internal IP subnet formed by the mesh network
            if MESH_USE_GLOBAL_DNS_IP is enabled.
            Note: The IP address is in platform (not network)
            format.

endmenu

menu "Example OTA Configuration"

    config EXAMPLE_FIRMWARE_UPGRADE_URL
        string "firmware upgrade url endpoint"
        default "https://192.168.0.3:8070/hello_world.bin"
        help
            URL of server which hosts the firmware
            image.

    config EXAMPLE_USE_CERT_BUNDLE
        bool "Enable certificate bundle"
        default y
        depends on MBEDTLS_CERTIFICATE_BUNDLE
        help
            Enable trusted root certificate bundle. This approach allows to have
            OTA updates functional with any public server without requirement
            to explicitly add its server certificate.

    config EXAMPLE_FIRMWARE_UPGRADE_URL_FROM_STDIN
        bool
        default y if EXAMPLE_FIRMWARE_UPGRADE_URL = "FROM_STDIN"

    config EXAMPLE_SKIP_COMMON_NAME_CHECK
        bool "Skip server certificate CN fieldcheck"
        default n
        help
            This allows you to skip the validation of OTA server certificate CN field.

    config EXAMPLE_FIRMWARE_UPGRADE_BIND_IF
        bool "Support firmware upgrade bind specified interface"
        default n
        help
            This allows you to bind specified interface in OTA example.

    choice EXAMPLE_FIRMWARE_UPGRADE_BIND_IF_TYPE
        prompt "Choose OTA data bind interface"
        default EXAMPLE_FIRMWARE_UPGRADE_BIND_IF_STA
        depends on EXAMPLE_FIRMWARE_UPGRADE_BIND_IF
        help
            Select which interface type of OTA data go through.

        config EXAMPLE_FIRMWARE_UPGRADE_BIND_IF_STA
            bool "Bind wifi station interface"
            depends on EXAMPLE_CONNECT_WIFI
            help
                Select wifi station interface to pass the OTA data.

        config EXAMPLE_FIRMWARE_UPGRADE_BIND_IF_ETH
            bool "Bind ethernet interface"
            depends on EXAMPLE_CONNECT_ETHERNET
            help
                Select ethernet interface to pass the OTA data.
    endchoice
endmenu

menu "Example TCP-Server Configuration(Stella)"

    config EXAMPLE_IPV4_SERVER
        bool "IPV4_SERVER"
        default y
        depends on LWIP_IPV4

    config EXAMPLE_IPV6_SERVER
        bool "IPV6_SERVER"
        default n
        select EXAMPLE_CONNECT_IPV6

    config EXAMPLE_SERVER_PORT
        int "Server_Port"
        range 0 65535
        default 3333
        help
            Local port the example server will listen on.

    config EXAMPLE_KEEPALIVE_IDLE
        int "TCP keep-alive idle time(s)"
        default 5
        help
            Keep-alive idle time. In idle time without receiving any data from peer, will send keep-alive probe packet

    config EXAMPLE_KEEPALIVE_INTERVAL
        int "TCP keep-alive interval time(s)"
        default 5
        help
            Keep-alive probe packet interval time.

    config EXAMPLE_KEEPALIVE_COUNT
        int "TCP keep-alive packet retry send counts"
        default 3
        help
            Keep-alive probe packet retry count.
endmenu

#menu "Example TCP_SERVER Configuration(IOTech)"
#
#    config EXAMPLE_IPV4
#        bool "IPV4"
#        default y
#        depends on LWIP_IPV4
#
#    config EXAMPLE_IPV6
#        bool "IPV6"
#        default n
#        select EXAMPLE_CONNECT_IPV6
#
#    config EXAMPLE_PORT
#        int "Port"
#        range 0 65535
#        default 3333
#        help
#            Local port the example server will listen on.
#
#    config EXAMPLE_KEEPALIVE_IDLE
#        int "TCP keep-alive idle time(s)"
#        default 5
#        help
#            Keep-alive idle time. In idle time without receiving any data from peer, will send keep-alive probe packet
#
#    config EXAMPLE_KEEPALIVE_INTERVAL
#        int "TCP keep-alive interval time(s)"
#        default 5
#        help
#            Keep-alive probe packet interval time.
#
#    config EXAMPLE_KEEPALIVE_COUNT
#        int "TCP keep-alive packet retry send counts"
#        default 3
#        help
#            Keep-alive probe packet retry count.
#endmenu

menu "Example SNTP Configuration"

    config SNTP_TIME_SERVER
        string "SNTP server name"
        default "pool.ntp.org"
        help
            Hostname of the main SNTP server.

    choice SNTP_TIME_SYNC_METHOD
        prompt "Time synchronization method"
        default SNTP_TIME_SYNC_METHOD_IMMED
        help
            Time synchronization method.

        config SNTP_TIME_SYNC_METHOD_IMMED
            bool "update time immediately when received"
        config SNTP_TIME_SYNC_METHOD_SMOOTH
            bool "update time with smooth method (adjtime)"
        config SNTP_TIME_SYNC_METHOD_CUSTOM

            bool "custom implementation"
    endchoice

endmenu
```
